## Documentation/devicetree/bindings/rtc/pcf8563.txt
```
* Philips PCF8563/Epson RTC8564 Real Time Clock

Philips PCF8563/Epson RTC8564 Real Time Clock

Required properties:
- compatible: Should contain "nxp,pcf8563",
	"epson,rtc8564" or
	"microcrystal,rv8564"
- reg: I2C address for chip.

Optional property:
- #clock-cells: Should be 0.
- clock-output-names:
  overwrite the default clock name "pcf8563-clkout"
- nxp,keep-clkout: Preserve the existing CLKOUT register during probe and
  prevent the common clock framework from disabling an unused output. This
  board-specific extension supports an always-on wireless reference clock.
- interrupts: The alarm interrupt. Its specified trigger type is honored,
  including falling-edge interrupts routed through a PCA953x GPIO expander.

Example:

pcf8563: pcf8563@51 {
	compatible = "nxp,pcf8563";
	reg = <0x51>;
	#clock-cells = <0>;
};

device {
...
	clocks = <&pcf8563>;
...
};
```
